## app/boards/arm/airport_shuttle/Kconfig
```kconfig
# SPDX-License-Identifier: MIT
CONFIG_ZMK_USB_LOGGING=y

config BOARD_ENABLE_DCDC
	bool "Enable DCDC mode"
	select SOC_DCDC_NRF52X
	default y
	depends on BOARD_AIRPORT_SHUTTLE
 
```
